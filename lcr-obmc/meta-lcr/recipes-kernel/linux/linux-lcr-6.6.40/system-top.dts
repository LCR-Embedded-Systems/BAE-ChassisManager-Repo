/*
 * CAUTION: This file is automatically generated by Xilinx.
 * Version: XSCT 
 * Today is: Wed Feb 12 16:05:35 2025
 */


/dts-v1/;
#include "zynq-7000.dtsi"
#include "zc702.dtsi"
#include "pl.dtsi"
#include "pcw.dtsi"
/ {
	chosen {
		bootargs = "earlycon";
		stdout-path = "serial0:115200n8";
	};
	aliases {
		ethernet0 = &gem0;
		ethernet1 = &gem1;
		i2c0 = &i2c0;
		i2c1 = &i2c1;
		i2c2 = &axi_iic_fan_ctrl;
		i2c3 = &axi_iic_si_osc;
		i2c4 = &axi_iic_temp_sensor;
		i2c5 = &axi_iic_temp_sensor2;
		i2c6 = &axi_iic_temp_sensor3;
		i2c7 = &axi_iic_temp_sensor4;
		serial0 = &uart1;
		serial1 = &uart0;
		spi0 = &qspi;
		spi1 = &axi_quad_spi_0;
	};
	memory@0 {
		device_type = "memory";
		reg = <0x0 0x40000000>;
	};
};
#include "system-user.dtsi"
