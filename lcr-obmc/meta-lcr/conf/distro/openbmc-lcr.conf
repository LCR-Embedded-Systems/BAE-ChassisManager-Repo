## lcr-obmc/meta-lcr/conf/distro/openbmc-lcr.conf
```bitbake
require conf/distro/include/phosphor-base.inc

DISTRO_FEATURES_BACKFILL_CONSIDERED:remove = "gobject-introspection-data"

KERNEL_CLASSES:remove = "obmc-phosphor-kernel-version"
```

## lcr-obmc/meta-lcr/conf/layer.conf
```bitbake
# We have a conf and classes directory, add to BBPATH
BBPATH .= ":${LAYERDIR}"

BBFILES += "${LAYERDIR}/recipes-*/*/*.bb \
            ${LAYERDIR}/recipes-*/*/*.bbappend"

BBFILE_COLLECTIONS += "lcrbmc"
BBFILE_PATTERN_lcrbmc = "^${LAYERDIR}/"
LAYERVERSION_lcrbmc = "1"
LAYERSERIES_COMPAT_lcrbmc = "mickledore"
```

## lcr-obmc/meta-lcr/conf/machine/zc702-zynq7.conf
```bitbake
PREFERRED_PROVIDER_virtual/bootloader ?= "u-boot-lcr"
PREFERRED_PROVIDER_u-boot ?= "u-boot-lcr"

PREFERRED_PROVIDER_virtual/kernel ?= "linux-lcr"
PREFERRED_VERSION_linux-enclustra ?= "5.15%"

PREFERRED_PROVIDER_enzianbmc-fpga = "enzianbmc-zx5-fpga"

MACHINE_FEATURES = "ext2 vfat usbhost"

DEFAULTTUNE ?= "cortexa9hf-vfpv3"
require conf/machine/include/arm/armv7a/tune-cortexa9.inc

UBOOT_MACHINE = "lcr_bootloader_defconfig"
# UBOOT_MACHINE = "lcr_bootloader_defconfig"
SPL_BINARY = "spl/boot.bin"
SPL_SUFFIX = "bin"
UBOOT_SUFFIX = "itb"
UBOOT_ELF = "u-boot.elf"
UBOOT_ENV = "boot"
UBOOT_ENV_SUFFIX = "scr"

SERIAL_CONSOLES = "115200;ttyPS0 115200;ttyPS1"

KERNEL_IMAGETYPE = "zImage"

KERNEL_DEVICETREE = "system-top.dtb"

# Overwrite flash offsets
# FLASH_UBOOT_OFFSET = "0"
# FLASH_KERNEL_OFFSET = "6144"
# FLASH_UBI_OFFSET = "${FLASH_KERNEL_OFFSET}"
# FLASH_ROFS_OFFSET = "12288"
# FLASH_RWFS_OFFSET = "65024"
# FLASH_SIZE = "65536"

IMAGE_FSTYPES = "cpio cpio.gz cpio.gz.u-boot ext4 tar.gz ubi"
MKUBIFS_ARGS = "-m 2048 -e 126976 -c 2000"
UBINIZE_ARGS = "-m 2048 -p 128KiB"
```

## lcr-obmc/meta-lcr/recipes-bsp/u-boot/u-boot-lcr/zc702-zynq7/enzianbmc.its
```
/dts-v1/;

/ {
    description = "Boot firmware image for Enzian BMC on Mercury ZX5";
    creator = "schwyda";
    #address-cells = <0x01>;

    images {

        u_boot {
            description = "U-Boot (32-bit)";
            type = "firmware";
            arch = "arm";
            os = "u-boot";
            data = /incbin/("u-boot-nodtb.bin");
            compression = "none";
            load = <0x4000000>;
            entry = <0x4000000>;
            hash-1 {
                algo = "sha1";
            };
        };

        fdt {
            description = "U-Boot device tree";
            type = "flat_dt";
            arch = "arm";
            compression = "none";
            data = /incbin/("u-boot.dtb");
            hash-1 {
                algo = "sha1";
            };
        };

        fpga {
            description = "Bitstream";
              type = "fpga";
            arch = "arm";
            data = /incbin/("../recipe-sysroot/sysroot-only/bitstream.bin");
            compression = "none";
            load = <0x400000>;
            hash-1 {
                algo = "sha1";
            };
        };
    };

    configurations {
        default = "enzianbmc-zx5";

        enzianbmc-zx5 {
            description = "Enzian BMC on Mercury ZX5";
            firmware = "u_boot";
            fdt = "fdt";
            fpga = "fpga";
        };
    };
};
```

## lcr-obmc/petalinux-files/utils/lcr-image.its
```
    /dts-v1/;
     
    / {
        description = "fitImage configuration for LCR's image.ub";
        #address-cells = <1>;
     
        images {
            kernel-1 {
                description = "Linux Kernel";
                data = /incbin/("zImage");
                type = "kernel";
                arch = "arm";
                os = "linux";
                compression = "none";
                load = <0x00200000>;
                entry = <0x00200000>;
                hash-1 {
                    algo = "sha256";
                };
            };
            fdt-system-top.dtb {
                description = "Flattened Device Tree blob";
                data = /incbin/("system.dtb");
                type = "flat_dt";
                arch = "arm";
                compression = "none";
                hash-1 {
                    algo = "sha256";
                };
            };
            ramdisk-1 {
                description = "ramdisk";
                data = /incbin/("rootfs.cpio.gz");
                type = "ramdisk";
                arch = "arm";
                os = "linux";
                compression = "none";
                hash-1 {
                    algo = "sha256";
                };
            };
        };
        configurations {
            default = "conf-system-top.dtb";
            conf-system-top.dtb {
                description = "Boot Linux kernel with FDT blob \+ ramdisk";
                kernel = "kernel-1";
                fdt = "fdt-system-top.dtb";
                ramdisk = "ramdisk-1";
                hash-1 {
                    algo = "sha256";
                };
            };
        };
    };
```
